## app/boards/shields/origin/Kconfig.defconfig
```kconfig
if SHIELD_ORIGIN_RIGHT

config ZMK_KEYBOARD_NAME
    default "Origin"

config ZMK_SPLIT_ROLE_CENTRAL
    default y

endif

if SHIELD_ORIGIN_LEFT || SHIELD_ORIGIN_RIGHT

config ZMK_SPLIT
    default y

endif
```

## app/boards/shields/origin/Kconfig.shield
```kconfig
config SHIELD_ORIGIN_LEFT
    def_bool $(shields_list_contains,origin_left)

config SHIELD_ORIGIN_RIGHT
    def_bool $(shields_list_contains,origin_right)
```

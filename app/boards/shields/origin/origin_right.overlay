/*
 * Copyright (c) 2020 The ZMK Contributors
 *
 * SPDX-License-Identifier: MIT
 */

#include "origin.dtsi"

&default_transform {
	col-offset = <18>;
};


&kscan0 {
    compatible = "zmk,kscan-gpio-direct";
    input-gpios
    = <&gpio0 2 (GPIO_ACTIVE_LOW | GPIO_PULL_UP)>
    , <&gpio1 13 (GPIO_ACTIVE_LOW | GPIO_PULL_UP)>
    , <&gpio0 17 (GPIO_ACTIVE_LOW | GPIO_PULL_UP)>
    , <&gpio0 20 (GPIO_ACTIVE_LOW | GPIO_PULL_UP)>
    , <&gpio1 2 (GPIO_ACTIVE_LOW | GPIO_PULL_UP)>

    , <&gpio0 29 (GPIO_ACTIVE_LOW | GPIO_PULL_UP)>
    , <&gpio1 11 (GPIO_ACTIVE_LOW | GPIO_PULL_UP)>
    , <&gpio0 24 (GPIO_ACTIVE_LOW | GPIO_PULL_UP)>
    , <&gpio0 22 (GPIO_ACTIVE_LOW | GPIO_PULL_UP)>
    , <&gpio1 1 (GPIO_ACTIVE_LOW | GPIO_PULL_UP)>

    , <&gpio1 15 (GPIO_ACTIVE_LOW | GPIO_PULL_UP)>
    , <&gpio0 10 (GPIO_ACTIVE_LOW | GPIO_PULL_UP)>
    , <&gpio0 9 (GPIO_ACTIVE_LOW | GPIO_PULL_UP)>
    , <&gpio1 0 (GPIO_ACTIVE_LOW | GPIO_PULL_UP)>
    , <&gpio1 7 (GPIO_ACTIVE_LOW | GPIO_PULL_UP)>

    , <&gpio0 11 (GPIO_ACTIVE_LOW | GPIO_PULL_UP)>
    , <&gpio1 4 (GPIO_ACTIVE_LOW | GPIO_PULL_UP)>
    , <&gpio1 6 (GPIO_ACTIVE_LOW | GPIO_PULL_UP)>
    // , <&gpio1 01 (GPIO_ACTIVE_LOW | GPIO_PULL_UP)>
    // , <&gpio1 02 (GPIO_ACTIVE_LOW | GPIO_PULL_UP)>
    // , <&gpio1 07 (GPIO_ACTIVE_LOW | GPIO_PULL_UP)>
    ;
};